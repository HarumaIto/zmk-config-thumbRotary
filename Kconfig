## Kconfig
```kconfig
# Copyright (c) 2024 The ZMK Contributors
# SPDX-License-Identifier: MIT

config ZMK_BEHAVIOR_INPUT_TAP
    bool "Single-shot input event behavior (for rotary-encoder mouse move)"
    default y
    depends on DT_HAS_ZMK_BEHAVIOR_INPUT_TAP_ENABLED && ZMK_POINTING
```

## boards/shields/thumbRotary/Kconfig.defconfig
```kconfig
if SHIELD_THUMBROTARY_LEFT

config ZMK_KEYBOARD_NAME
	default "tr_l"

config ZMK_SPLIT_BLE_ROLE_CENTRAL
	default y

endif

if SHIELD_THUMBROTARY_RIGHT

config ZMK_KEYBOARD_NAME
	default "tr_r"
	
endif

if SHIELD_THUMBROTARY_LEFT || SHIELD_THUMBROTARY_RIGHT

config ZMK_SPLIT
	default y

endif
```

## boards/shields/thumbRotary/Kconfig.shield
```kconfig
# Copyright (c) 2020 Pete Johanson
# SPDX-License-Identifier: MIT

config SHIELD_THUMBROTARY_LEFT
	def_bool $(shields_list_contains,thumbRotary_left)

config SHIELD_THUMBROTARY_RIGHT
	def_bool $(shields_list_contains,thumbRotary_right)
```

## dts/bindings/behaviors/zmk,behavior-input-tap.yaml
```yaml
# Copyright (c) 2024 The ZMK Contributors
# SPDX-License-Identifier: MIT

description: |
  Single-shot input event behavior. On each binding press, immediately emits a
  one-shot relative input event (e.g. INPUT_REL_X / INPUT_REL_Y). On release,
  performs no action. Useful for sensor rotation (rotary encoder) bindings that
  should produce one pointer movement per tick.

compatible: "zmk,behavior-input-tap"

include: one_param.yaml

properties:
  x-input-code:
    type: int
    description: Input event code for the X-axis component of the encoded MOVE value.
  y-input-code:
    type: int
    description: Input event code for the Y-axis component of the encoded MOVE value.
```
